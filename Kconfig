## Kconfig
```kconfig
menu "MT6701 Driver Configuration"

    config MT6701_THREAD_SAFE
        bool "Protect each MT6701 instance with a mutex"
        default y
        help
            When enabled, each mt6701_dev_t contains a statically allocated
            FreeRTOS mutex. The driver uses it to serialize I2C transactions and
            access to calibration, multi-turn, angle-cache, and velocity state.

            Disable this option only when one task owns each instance and no
            concurrent task or ISR can access it. Disabling compiles out all
            mutex operations and reduces the overhead of a high-rate control
            path. Sensor-reading APIs remain unsuitable for ISR use because the
            ESP-IDF I2C master transaction is blocking.

endmenu
```

## test_apps/dual_i2c/main/Kconfig.projbuild
```kconfig
menu "Dual MT6701 hardware test"
config MT6701_TEST_SDA_GPIO
    int "I2C SDA GPIO"
    range 0 21
    default 8
config MT6701_TEST_SCL_GPIO
    int "I2C SCL GPIO"
    range 0 21
    default 9
config MT6701_TEST_I2C_HZ
    int "I2C bus frequency (Hz)"
    range 10000 400000
    default 400000
config MT6701_TEST_LEFT_ADDRESS
    hex "LEFT sensor I2C address (7-bit)"
    range 0x01 0x77
    default 0x06
config MT6701_TEST_RIGHT_ADDRESS
    hex "RIGHT sensor I2C address (7-bit)"
    range 0x01 0x77
    default 0x46
endmenu
```

## test_apps/dual_i2c/sdkconfig.defaults
```kconfig
CONFIG_IDF_TARGET="esp32c3"
CONFIG_FREERTOS_HZ=1000
CONFIG_ESP_MAIN_TASK_STACK_SIZE=6144
CONFIG_ESP_CONSOLE_USB_SERIAL_JTAG=y
CONFIG_ESP_CONSOLE_SECONDARY_NONE=y
CONFIG_ESP_RT_DIAGNOSTICS_ENABLE=y
CONFIG_ESP_RT_DIAGNOSTICS_DETAILED_TIMING=y
```
